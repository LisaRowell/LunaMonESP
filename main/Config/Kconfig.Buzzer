## main/Config/Kconfig.Buzzer
```kconfig
menu "Buzzer Configuration"

    config LUNAMON_HAS_BUZZER
        bool "Has Alarm Buzzer"
        default n
        help
            Whether or not the unit has a buzzer which can be used to signal alarm conditions.

    config LUNAMON_BUZZER_GPIO
        int "Buzzer Pin" if LUNAMON_HAS_BUZZER
        default 5
        help
            GPIO pin number where a buzzer circuit connected. Consult your board documentation for
            information on which pin to use.

    config LUNAMON_BUZZER_ENABLED
        int
        default 1 if LUNAMON_HAS_BUZZER
        default 0 if !LUNAMON_HAS_BUZZER

    config LUNAMON_BUZZER_CHIRP_AT_STARTUP
        bool "Enable a buzzer chirp at startup" if LUNAMON_HAS_BUZZER
        help
            Perform a short buzzer chirp at startup.

    config LUNAMON_BUZZER_CHIRP_AT_STARTUP_ENABLED
        int
        default 1 if LUNAMON_BUZZER_CHIRP_AT_STARTUP
        default 0 if !LUNAMON_BUZZER_CHIRP_AT_STARTUP

endmenu
```

## main/Config/Kconfig.Debug
```kconfig
menu "Debug config"
    config LUNAMON_DEBUG_MODULE_MAIN
        bool "Debug Main"
        help
            Whether or not to debug the main module.

    config LUNAMON_DEBUG_MODULE_MAIN_ENABLED
        int
        default 1 if LUNAMON_DEBUG_MODULE_MAIN
        default 0 if !LUNAMON_DEBUG_MODULE_MAIN

    config LUNAMON_DEBUG_MODULE_DATA_MODEL
        bool "Debug DataModel"
        help
            Whether or not to debug the DataModel module.

    config LUNAMON_DEBUG_MODULE_DATA_MODEL_ENABLED
        int
        default 1 if LUNAMON_DEBUG_MODULE_DATA_MODEL
        default 0 if !LUNAMON_DEBUG_MODULE_DATA_MODEL

    config LUNAMON_DEBUG_MODULE_MQTT
        bool "Debug MQTT"
        help
            Whether or not to debug the MQTT module.

    config LUNAMON_DEBUG_MODULE_MQTT_ENABLED
        int
        default 1 if LUNAMON_DEBUG_MODULE_MQTT
        default 0 if !LUNAMON_DEBUG_MODULE_MQTT

    config LUNAMON_DEBUG_MODULE_NMEA
        bool "Debug NMEA"
        help
            Whether or not to debug the NMEA module.

    config LUNAMON_DEBUG_MODULE_NMEA_ENABLED
        int
        default 1 if LUNAMON_DEBUG_MODULE_NMEA
        default 0 if !LUNAMON_DEBUG_MODULE_NMEA

    config LUNAMON_DEBUG_MODULE_DATA_MODEL_BRIDGE
        bool "Debug DataModelBridge"
        help
            Whether or not to debug the DataModelBridge module.

    config LUNAMON_DEBUG_MODULE_DATA_MODEL_BRIDGE_ENABLED
        int
        default 1 if LUNAMON_DEBUG_MODULE_DATA_MODEL_BRIDGE
        default 0 if !LUNAMON_DEBUG_MODULE_DATA_MODEL_BRIDGE

    config LUNAMON_DEBUG_MODULE_NMEA_WIFI
        bool "Debug NMEAWiFi"
        help
            Whether or not to debug the NMEAWiFi module.

    config LUNAMON_DEBUG_MODULE_NMEA_WIFI_ENABLED
        int
        default 1 if LUNAMON_DEBUG_MODULE_NMEA_WIFI
        default 0 if !LUNAMON_DEBUG_MODULE_NMEA_WIFI

    config LUNAMON_DEBUG_MODULE_NMEA_UART
        bool "Debug NMEA UART"
        help
            Whether or not to debug the NMEA UART module.

    config LUNAMON_DEBUG_MODULE_NMEA_UART_ENABLED
        int
        default 1 if LUNAMON_DEBUG_MODULE_NMEA_UART
        default 0 if !LUNAMON_DEBUG_MODULE_NMEA_UART

    config LUNAMON_DEBUG_MODULE_NMEA_SOFT_UART
        bool "Debug NMEA Software UART"
        help
            Whether or not to debug the NMEA Software UART module.

    config LUNAMON_DEBUG_MODULE_NMEA_SOFT_UART_ENABLED
        int
        default 1 if LUNAMON_DEBUG_MODULE_NMEA_SOFT_UART
        default 0 if !LUNAMON_DEBUG_MODULE_NMEA_SOFT_UART

    config LUNAMON_DEBUG_MODULE_NMEA_RMT_UART
        bool "Debug NMEA RMT UART"
        help
            Whether or not to debug the NMEA RMT UART module.

    config LUNAMON_DEBUG_MODULE_NMEA_RMT_UART_ENABLED
        int
        default 1 if LUNAMON_DEBUG_MODULE_NMEA_RMT_UART
        default 0 if !LUNAMON_DEBUG_MODULE_NMEA_RMT_UART

    config LUNAMON_DEBUG_MODULE_STALK
        bool "Debug STALK"
        help
            Whether or not to debug the STALK module.

    config LUNAMON_DEBUG_MODULE_STALK_ENABLED
        int
        default 1 if LUNAMON_DEBUG_MODULE_STALK
        default 0 if !LUNAMON_DEBUG_MODULE_STALK

    config LUNAMON_DEBUG_MODULE_STALK_UART
        bool "Debug STALK UART"
        help
            Whether or not to debug the STALK UART module.

    config LUNAMON_DEBUG_MODULE_STALK_UART_ENABLED
        int
        default 1 if LUNAMON_DEBUG_MODULE_STALK_UART
        default 0 if !LUNAMON_DEBUG_MODULE_STALK_UART

    config LUNAMON_DEBUG_MODULE_STALK_RMT_UART
        bool "Debug STALK RMT UART"
        help
            Whether or not to debug the STALK RMT UART module.

    config LUNAMON_DEBUG_MODULE_STALK_RMT_UART_ENABLED
        int
        default 1 if LUNAMON_DEBUG_MODULE_STALK_RMT_UART
        default 0 if !LUNAMON_DEBUG_MODULE_STALK_RMT_UART

    config LUNAMON_DEBUG_MODULE_SEA_TALK
        bool "Debug SeaTalk"
        help
            Whether or not to debug the SeaTalk module.

    config LUNAMON_DEBUG_MODULE_SEA_TALK_ENABLED
        int
        default 1 if LUNAMON_DEBUG_MODULE_SEA_TALK
        default 0 if !LUNAMON_DEBUG_MODULE_SEA_TALK

    config LUNAMON_DEBUG_MODULE_SEA_TALK_RMT_UART
        bool "Debug SeaTalk RMT UART"
        help
            Whether or not to debug the SeaTalk RMT UART module.

    config LUNAMON_DEBUG_MODULE_SEA_TALK_RMT_UART_ENABLED
        int
        default 1 if LUNAMON_DEBUG_MODULE_SEA_TALK_RMT_UART
        default 0 if !LUNAMON_DEBUG_MODULE_SEA_TALK_RMT_UART

    config LUNAMON_DEBUG_MODULE_NMEA_SERVER
        bool "Debug NMEA Server"
        help
            Whether or not to debug the NMEA Server module.

    config LUNAMON_DEBUG_MODULE_NMEA_SERVER_ENABLED
        int
        default 1 if LUNAMON_DEBUG_MODULE_NMEA_SERVER
        default 0 if !LUNAMON_DEBUG_MODULE_NMEA_SERVER

    config LUNAMON_DEBUG_MODULE_NMEA_BRIDGE
        bool "Debug NMEA Bridge"
        help
            Whether or not to debug the NMEA Bridge module.

    config LUNAMON_DEBUG_MODULE_NMEA_BRIDGE_ENABLED
        int
        default 1 if LUNAMON_DEBUG_MODULE_NMEA_BRIDGE
        default 0 if !LUNAMON_DEBUG_MODULE_NMEA_BRIDGE

    config LUNAMON_DEBUG_MODULE_NMEA_LINE
        bool "Debug NMEA Line"
        help
            Whether or not to debug the NMEA Line module.

    config LUNAMON_DEBUG_MODULE_NMEA_LINE_ENABLED
        int
        default 1 if LUNAMON_DEBUG_MODULE_NMEA_LINE
        default 0 if !LUNAMON_DEBUG_MODULE_NMEA_LINE

    config LUNAMON_DEBUG_MODULE_UART
        bool "Debug UART"
        help
            Whether or not to debug the UART module.

    config LUNAMON_DEBUG_MODULE_UART_ENABLED
        int
        default 1 if LUNAMON_DEBUG_MODULE_UART
        default 0 if !LUNAMON_DEBUG_MODULE_UART

    config LUNAMON_DEBUG_MODULE_SOFT_UART
        bool "Debug Software UART"
        help
            Whether or not to debug the Software UART module.

    config LUNAMON_DEBUG_MODULE_SOFT_UART_ENABLED
        int
        default 1 if LUNAMON_DEBUG_MODULE_SOFT_UART
        default 0 if !LUNAMON_DEBUG_MODULE_SOFT_UART

    config LUNAMON_DEBUG_MODULE_AIS
        bool "Debug AIS"
        help
            Whether or not to debug the AIS module.

    config LUNAMON_DEBUG_MODULE_AIS_ENABLED
        int
        default 1 if LUNAMON_DEBUG_MODULE_AIS
        default 0 if !LUNAMON_DEBUG_MODULE_AIS

    config LUNAMON_DEBUG_MODULE_RMT_UART
        bool "Debug RMT UART"
        help
            Whether or not to debug the RMT UART module.

    config LUNAMON_DEBUG_MODULE_RMT_UART_ENABLED
        int
        default 1 if LUNAMON_DEBUG_MODULE_RMT_UART
        default 0 if !LUNAMON_DEBUG_MODULE_RMT_UART

    config LUNAMON_DEBUG_MODULE_WIFI_INTERFACE
        bool "Debug WiFiInterface"
        help
            Whether or not to debug the WiFiInterface module.

    config LUNAMON_DEBUG_MODULE_WIFI_INTERFACE_ENABLED
        int
        default 1 if LUNAMON_DEBUG_MODULE_WIFI_INTERFACE
        default 0 if !LUNAMON_DEBUG_MODULE_WIFI_INTERFACE

    config LUNAMON_DEBUG_MODULE_WIFI_MANAGER
        bool "Debug WiFiManager"
        help
            Whether or not to debug the WiFiManager module.

    config LUNAMON_DEBUG_MODULE_WIFI_MANAGER_ENABLED
        int
        default 1 if LUNAMON_DEBUG_MODULE_WIFI_MANAGER
        default 0 if !LUNAMON_DEBUG_MODULE_WIFI_MANAGER

    config LUNAMON_DEBUG_MODULE_STATS_MANAGER
        bool "Debug StatsManager"
        help
            Whether or not to debug the StatsManager module.

    config LUNAMON_DEBUG_MODULE_STATS_MANAGER_ENABLED
        int
        default 1 if LUNAMON_DEBUG_MODULE_STATS_MANAGER
        default 0 if !LUNAMON_DEBUG_MODULE_STATS_MANAGER

    config LUNAMON_DEBUG_MODULE_I2C_MASTER
        bool "Debug I2CMaster"
        help
            Whether or not to debug the I2CMaster module.

    config LUNAMON_DEBUG_MODULE_I2C_MASTER_ENABLED
        int
        default 1 if LUNAMON_DEBUG_MODULE_I2C_MASTER
        default 0 if !LUNAMON_DEBUG_MODULE_I2C_MASTER

    config LUNAMON_DEBUG_MODULE_BME280_DRIVER
        bool "Debug BME280Driver"
        help
            Whether or not to debug the BME280Driver module.

    config LUNAMON_DEBUG_MODULE_BME280_DRIVER_ENABLED
        int
        default 1 if LUNAMON_DEBUG_MODULE_BME280_DRIVER
        default 0 if !LUNAMON_DEBUG_MODULE_BME280_DRIVER

    config LUNAMON_DEBUG_MODULE_ENS160_DRIVER
        bool "Debug ENS160Driver"
        help
            Whether or not to debug the ENS169Driver module.

    config LUNAMON_DEBUG_MODULE_ENS160_DRIVER_ENABLED
        int
        default 1 if LUNAMON_DEBUG_MODULE_ENS160_DRIVER
        default 0 if !LUNAMON_DEBUG_MODULE_ENS160_DRIVER

    config LUNAMON_DEBUG_MODULE_ENVIRONMENTAL_MON
        bool "Debug EnvironmentalMon"
        help
            Whether or not to debug the EnvironmentalMon module.

    config LUNAMON_DEBUG_MODULE_ENVIRONMENTAL_MON_ENABLED
        int
        default 1 if LUNAMON_DEBUG_MODULE_ENVIRONMENTAL_MON
        default 0 if !LUNAMON_DEBUG_MODULE_ENVIRONMENTAL_MON

    config LUNAMON_DEBUG_MODULE_TASK_OBJECT
        bool "Debug TaskObject"
        help
            Whether or not to debug the TaskObject module.

    config LUNAMON_DEBUG_MODULE_TASK_OBJECT_ENABLED
        int
        default 1 if LUNAMON_DEBUG_MODULE_TASK_OBJECT
        default 0 if !LUNAMON_DEBUG_MODULE_TASK_OBJECT

endmenu
```

## main/Config/Kconfig.Extras
```kconfig
menu "Extras"

    config LUNAMON_ENABLE_DIGITAL_YACHTS_STALK_WORKAROUND
        bool "Enable Digital Yachts $STALK workaround"
        help
            Certain version of Digital Yachts ST-NEMA (ISO) Converter have a bug which causes
            their command to turn on $STALK output to not be saved in non-volatile memory. This
            option, when enabled, will cause Luna Mon to detect when normal NMEA 0183 messages are
            being received on a STALK interface and try to reconfigure the device on the fly.

    config LUNAMON_DIGITAL_YACHTS_STALK_WORKAROUND_ENABLED
        int
        default 1 if LUNAMON_ENABLE_DIGITAL_YACHTS_STALK_WORKAROUND
        default 0 if !LUNAMON_ENABLE_DIGITAL_YACHTS_STALK_WORKAROUND

    config LUNAMON_ENABLE_SEA_TALK_WRITE_TEST
        bool "Enable a test that writes to commands to SeaTalk (and $STALK) interfaces"
        help
            Perform periodic $STALK commands that cycle through lamp britenesses of displays.

    config LUNAMON_SEA_TALK_WRITE_TEST_ENABLED
        int
        default 1 if LUNAMON_ENABLE_SEA_TALK_WRITE_TEST
        default 0 if !LUNAMON_ENABLE_SEA_TALK_WRITE_TEST

endmenu
```

## main/Config/Kconfig.I2C
```kconfig
menu "I2C Device Configuration"

    config LUNAMON_HAS_I2C_DEVICES
        bool "Has I2C Devices"
        default n
        help
            Whether or not the unit has sensors such as a BME280 or an ENS160 attached via I2C.

    config LUNAMON_I2C_ENABLED
        int
        default 1 if LUNAMON_HAS_I2C_DEVICES
        default 0 if !LUNAMON_HAS_I2C_DEVICES

    choice 
        prompt "I2C Master ID" if LUNAMON_HAS_I2C_DEVICES
        default LUNAMON_I2C_MASTER_NUM_0
        help
            Some ESP variants have two I2C interfaces. Select which interface to use for Luna Mon 
            sensors.

        config LUNAMON_I2C_MASTER_NUM_0
            bool "0"
        config LUNAMON_I2C_MASTER_NUM_1
            bool "1"
    endchoice

    config LUNAMON_I2C_MASTER_NUM
        int
        default 0 if !LUNAMON_HAS_I2C_DEVICES
        default 0 if LUNAMON_I2C_MASTER_NUM_0
        default 1 if LUNAMON_I2C_MASTER_NUM_1
        
    config LUNAMON_I2C_MASTER_SCL_IO
        int "I2C SCL IO Pin" if LUNAMON_HAS_I2C_DEVICES
        default 22
        help
            Pin number to use for the I2C SCL. Consult your board documentation for information
            on which pin to use.

    config LUNAMON_I2C_MASTER_SDA_IO
        int "I2C SDA IO Pin" if LUNAMON_HAS_I2C_DEVICES
        default 23
        help
            Pin number to use for the I2C SDA. Consult your board documentation for information
            on which pin to use.

    config LUNAMON_HAS_BME280
        bool "Has BME280" if LUNAMON_HAS_I2C_DEVICES
        default n
        help
            Whether or not the unit has a BME280 sensor chip connected.

    config LUNAMON_BME280_ENABLED
        int
        default 1 if LUNAMON_HAS_BME280
        default 0 if !LUNAMON_HAS_BME280

    choice
        prompt "BME280 I2C Address" if LUNAMON_HAS_BME280
        default LUNAMON_BME280_ADDRESS_77
        help
            The BME280 defaults to I2C address 0x77, but can be configured hardware to be 0x76.
            Select the address used by your board.

        config LUNAMON_BME280_ADDRESS_77
            bool "0x77"
        config LUNAMON_BME280_ADDRESS_76
            bool "0x76"
    endchoice

    config LUNAMON_BME280_ADDRESS
        hex
        default 0x77 if !LUNAMON_HAS_BME280
        default 0x77 if LUNAMON_BME280_ADDRESS_77
        default 0x76 if LUNAMON_BME280_ADDRESS_76

    config LUNAMON_HAS_ENS160
        bool "Has ENS160" if LUNAMON_HAS_I2C_DEVICES
        default n
        help
            Whether or not the unit has a ENS160 sensor chip connected.

    config LUNAMON_ENS160_ENABLED
        int
        default 1 if LUNAMON_HAS_ENS160
        default 0 if !LUNAMON_HAS_ENS160

    choice
        prompt "ENS160 I2C Address" if LUNAMON_HAS_ENS160
        default LUNAMON_ENS160_ADDRESS_53
        help
            The ENS160 defaults to I2C address 0x53, but can be configured hardware to be 0x52.
            Select the address used by your board.

        config LUNAMON_ENS160_ADDRESS_53
            bool "0x53"
        config LUNAMON_ENS160_ADDRESS_52
            bool "0x52"
    endchoice

    config LUNAMON_ENS160_ADDRESS
        hex
        default 0x53 if !LUNAMON_HAS_ENS160
        default 0x53 if LUNAMON_ENS160_ADDRESS_53
        default 0x52 if LUNAMON_ENS160_ADDRESS_52

endmenu
```

## main/Config/Kconfig.LED
```kconfig
menu "LED Configuration"

    config LUNAMON_HAS_STATUS_LED
        bool "Has Status LED"
        default n
        help
            Whether or not the unit has a LED which can be used to flash status conditions.

    config LUNAMON_STATUS_LED_GPIO
        int "Status LED Pin" if LUNAMON_HAS_STATUS_LED
        default 13
        help
            GPIO pin number where a status LED is connected. Consult your board documentation for
            information on which pin to use.

    config LUNAMON_STATUS_LED_ENABLED
        int
        default 1 if LUNAMON_HAS_STATUS_LED
        default 0 if !LUNAMON_HAS_STATUS_LED

endmenu
```
