## main/Config/Kconfig.UART1
```kconfig
menu "UART1 Source Configuration"

    config LUNAMON_HAS_UART1_SOURCE
        bool "Has a serial source connected for UART1"
        default n
        help
            Whether or not there's a serial source connected to be configured as UART1.

    config LUNAMON_UART1_ENABLED
        int
        default 1 if LUNAMON_HAS_UART1_SOURCE
        default 0 if !LUNAMON_HAS_UART1_SOURCE

    config LUNAMON_UART1_LABEL
        string "UART1 interface label" if LUNAMON_HAS_UART1_SOURCE
        default ""
        help
            The label of the UART1 interface.

    choice
        prompt "UART1 Protocol" if LUNAMON_HAS_UART1_SOURCE
        default LUNAMON_UART1_NMEA_0183
        help
            Luna Mon supports interfaces with either NMEA 0183 messages or $STALK messages.
            NMEA 0183 is what is typically put out by older, non-Raymarine devices. SeaTalk
            is a proprietary protocol used by AutoHelm and Raymarine devices. $STALK is a
            packaging of SeaTalk messages into a NMEA 0183 message structure typically outputed
            by bridging devices such as the Digital Yachts ST-NMEA.

        config LUNAMON_UART1_NMEA_0183
            bool "NMEA 0183"
        config LUNAMON_UART1_STALK
            bool "$STALK"
    endchoice

    config LUNAMON_UART1_OFFLINE
        bool
        default y if !LUNAMON_HAS_UART1_SOURCE

    config LUNAMON_UART1_RX_PIN
        int "UART1 RX Pin" if LUNAMON_HAS_UART1_SOURCE
        default 38
        help
            Pin number to use for the UART1's RX pin. Consult your board documentation for
            information on which pin to use.

    config LUNAMON_UART1_TX_PIN
        int "UART1 TX Pin" if LUNAMON_HAS_UART1_SOURCE
        default 39
        help
            Pin number to use for the UART1's TX pin. Consult your board documentation for
            information on which pin to use.

    choice
        prompt "UART1 Baud Rate" if LUNAMON_HAS_UART1_SOURCE
        default LUNAMON_UART1_BAUD_RATE_4800
        help
            There are two baud rates used by NMEA 0183 devices, 4800 and 38400. Most devices
            use the former while AIS transceivers typically use the later. Since these are
            incompatible to directly connect, vessels would usually either run one of each to
            each MFD, or use a device (often the AIS) to bridge the slower feed onto the faster.
            SeaTalk runs native 4800 while a $STALK translation device might be 4800 or 38400.
            Select the speed of what's connected to UART1.

        config LUNAMON_UART1_BAUD_RATE_4800
            bool "4800"
        config LUNAMON_UART1_BAUD_RATE_38400
            bool "38400"
    endchoice

    config LUNAMON_UART1_BAUD_RATE
        int
        default 0 if !LUNAMON_HAS_UART1_SOURCE
        default 4800 if LUNAMON_UART1_BAUD_RATE_4800
        default 38400 if LUNAMON_UART1_BAUD_RATE_38400

endmenu
```

## main/Config/Kconfig.UART2
```kconfig
menu "UART2 Source Configuration"

    config LUNAMON_HAS_UART2_SOURCE
        bool "Has a serial source connected for UART2"
        default n
        help
            Whether or not there's a serial source connected to be configured as UART2.

    config LUNAMON_UART2_ENABLED
        int
        default 1 if LUNAMON_HAS_UART2_SOURCE
        default 0 if !LUNAMON_HAS_UART2_SOURCE

    config LUNAMON_UART2_LABEL
        string "UART2 interface label" if LUNAMON_HAS_UART2_SOURCE
        default ""
        help
            The label of the UART2 interface.

    choice
        prompt "UART2 Protocol" if LUNAMON_HAS_UART2_SOURCE
        default LUNAMON_UART2_NMEA_0183
        help
            Luna Mon supports interfaces with either NMEA 0183 messages or $STALK messages.
            NMEA 0183 is what is typically put out by older, non-Raymarine devices. SeaTalk
            is a proprietary protocol used by AutoHelm and Raymarine devices. $STALK is a
            packaging of SeaTalk messages into a NMEA 0183 message structure typically outputed
            by bridging devices such as the Digital Yachts ST-NMEA.

        config LUNAMON_UART2_NMEA_0183
            bool "NMEA 0183"
        config LUNAMON_UART2_STALK
            bool "$STALK"
    endchoice

    config LUNAMON_UART2_OFFLINE
        bool
        default y if !LUNAMON_HAS_UART2_SOURCE

    config LUNAMON_UART2_RX_PIN
        int "UART2 RX Pin" if LUNAMON_HAS_UART2_SOURCE
        default 18
        help
            Pin number to use for the UART2's RX pin. Consult your board documentation for
            information on which pin to use.

    config LUNAMON_UART2_TX_PIN
        int "UART2 TX Pin" if LUNAMON_HAS_UART2_SOURCE
        default 17
        help
            Pin number to use for the UART2's TX pin. Consult your board documentation for
            information on which pin to use.

    choice
        prompt "UART2 Baud Rate" if LUNAMON_HAS_UART2_SOURCE
        default LUNAMON_UART2_BAUD_RATE_4800
        help
            There are two baud rates used by NMEA 0183 devices, 4800 and 38400. Most devices
            use the former while AIS transceivers typically use the later. Since these are
            incompatible to directly connect, vessels would usually either run one of each to
            each MFD, or use a device (often the AIS) to bridge the slower feed onto the faster.
            SeaTalk runs native 4800 while a $STALK translation device might be 4800 or 38400.
            Select the speed of what's connected to UART2.

        config LUNAMON_UART2_BAUD_RATE_4800
            bool "4800"
        config LUNAMON_UART2_BAUD_RATE_38400
            bool "38400"
    endchoice

    config LUNAMON_UART2_BAUD_RATE
        int
        default 0 if !LUNAMON_HAS_UART2_SOURCE
        default 4800 if LUNAMON_UART2_BAUD_RATE_4800
        default 38400 if LUNAMON_UART2_BAUD_RATE_38400

    config LUNAMON_UART2_NMEA_0183_FILTERED_TALKERS
        string "Filtered NEMA 0183 Talkers" if LUNAMON_UART2_NMEA_0183
        default ""
        help
            A comma separated list of NMEA talker codes from whom messages are to be filtered.

endmenu
```

## main/Config/Kconfig.WiFi
```kconfig
menu "WiFi Configuration"
    config LUNAMON_HOST_NAME
        string "Host Name"
        default "LunaMon"
        help
            Device host name visible on the network by the router and other devices.

    config LUNAMON_WIFI_SSID
        string "WiFi SSID"
        default "myssid"
        help
            SSID (network name) for Luna Mon to connect to.

    config LUNAMON_WIFI_PASSWORD
        string "WiFi Password"
        default "mypassword"
        help
            WiFi password (WPA or WPA2) for Luna Mon to use.
endmenu
```

## main/Config/Kconfig.WiFiSource
```kconfig
menu "WiFi Source Configuration"

    config LUNAMON_HAS_NMEA_OVER_WIFI_SOURCE
        bool "Has NMEA over WiFi Source"
        default n
        help
            Whether or not there's a WiFi source for NMEA messages.

    config LUNAMON_NMEA_WIFI_ENABLED
        int
            default 1 if LUNAMON_HAS_NMEA_OVER_WIFI_SOURCE
            default 0 if !LUNAMON_HAS_NMEA_OVER_WIFI_SOURCE

    config LUNAMON_NMEA_WIFI_SOURCE_LABEL
        string "WiFi NMEA Source label" if LUNAMON_HAS_NMEA_OVER_WIFI_SOURCE
        default ""
        help
            The label of the NMEA over WiFi interface.

    config LUNAMON_NMEA_WIFI_SOURCE_IPV4_ADDR
        string "WiFi NMEA Source IPv4 Address" if LUNAMON_HAS_NMEA_OVER_WIFI_SOURCE
        default "1.1.1.1"
        help
            The IPv4 address of the NMEA source.

    config LUNAMON_NMEA_WIFI_SOURCE_TCP_PORT
        int "WiFi NMEA Source TCP Port" if LUNAMON_HAS_NMEA_OVER_WIFI_SOURCE
        default 39150
        help
            The TCP port number for the NMEA source.

endmenu
```

## main/Kconfig.projbuild
```kconfig
menu "Luna Mon Configuration"

    rsource "Config/Kconfig.WiFi"
    rsource "Config/Kconfig.MQTT"
    rsource "Config/Kconfig.WiFiSource"
    rsource "Config/Kconfig.UART1"
    rsource "Config/Kconfig.UART2"
    rsource "Config/Kconfig.RMTUART"
    rsource "Config/Kconfig.SoftwareUART"
    rsource "Config/Kconfig.NMEAServer"
    rsource "Config/Kconfig.NMEABridge"
    rsource "Config/Kconfig.SeaTalkNMEABridge"
    rsource "Config/Kconfig.Buzzer"
    rsource "Config/Kconfig.LED"
    rsource "Config/Kconfig.I2C"
    rsource "Config/Kconfig.Debug"
    rsource "Config/Kconfig.Extras"

endmenu
```
