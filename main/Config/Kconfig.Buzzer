## main/Config/Kconfig.MQTT
```kconfig
menu "MQTT Configuration"

    config LUNAMON_MAX_MQTT_CLIENTS
        int "Max MQTT Clients"
        default 5
        help
            The maximum allowed simultaneous MQTT client connections.

    config LUNAMON_MQTT_TCP_KEEPALIVE_IDLE
        int "TCP keep-alive idle time(s)"
        default 5
        help
            Keep-alive idle time. In idle time without receiving any data from peer, will send
            keep-alive probe packet.

    config LUNAMON_MQTT_TCP_KEEPALIVE_INTERVAL
        int "TCP keep-alive interval time(s)"
        default 5
        help
            Keep-alive probe packet interval time.

    config LUNAMON_MQTT_TCP_KEEPALIVE_COUNT
        int "TCP keep-alive packet retry send counts"
        default 3
        help
            Keep-alive probe packet retry count.

    config LUNAMON_MQTT_RECEIVE_BUFFER_SIZE
        int "TCP receive buffer size"
        default 8192
        help
            TCP receive buffer size in bytes.

endmenu
```

## main/Config/Kconfig.NMEABridge
```kconfig
menu "NMEA 0183 to NMEA 0183 Bridge Configuration"

    config LUNAMON_ENABLE_NMEA_BRIDGE
        bool "Enable a NMEA 0183 to NMEA 0183 message bridge"
        default n
        help
            Whether or not enable a bridge of messages between two NMEA 0183 interfaces.

    config LUNAMON_NMEA_BRIDGE_ENABLED
        int
        default 1 if LUNAMON_ENABLE_NMEA_BRIDGE
        default 0 if !LUNAMON_ENABLE_NMEA_BRIDGE

    config LUNAMON_NMEA_BRIDGE_NAME
        string "Bridge name" if LUNAMON_ENABLE_NMEA_BRIDGE
        default "bridge"
        help
            The name of the bridge as shown in log messages and in MQTT $SYS topics.

    choice
        prompt "Bridge source interface" if LUNAMON_ENABLE_NMEA_BRIDGE
        help
            The interface on which bridged messages are expected. This should be configured as
            a NMEA 0183 source.

        config LUNAMON_NMEA_BRIDGE_SOURCE_WIFI
            bool "WiFi" if LUNAMON_HAS_NMEA_OVER_WIFI_SOURCE
        config LUNAMON_NMEA_BRIDGE_SOURCE_UART1
            bool "UART1" if LUNAMON_UART1_NMEA_0183
        config LUNAMON_NMEA_BRIDGE_SOURCE_UART2
            bool "UART2" if LUNAMON_UART2_NMEA_0183
        config LUNAMON_NMEA_BRIDGE_SOURCE_RMT_UART
            bool "RMT UART" if LUNAMON_RMT_UART_NMEA_0183
        config LUNAMON_NMEA_BRIDGE_SOURCE_SOFT_UART
            bool "Software UART" if LUNAMON_SOFTWARE_UART_NMEA_0183
    endchoice

    config LUNAMON_NMEA_BRIDGE_SOURCE_NONE
        bool
        default y if !LUNAMON_ENABLE_NMEA_BRIDGE
        default y if !LUNAMON_HAS_NMEA_OVER_WIFI_SOURCE &&  \
                     !LUNAMON_UART1_NMEA_0183 &&            \
                     !LUNAMON_UART2_NMEA_0183 &&            \
                     !LUNAMON_RMT_UART_NMEA_0183 &&         \
                     !LUNAMON_SOFTWARE_UART_NMEA_0183

    choice
        prompt "Bridge destination interface" if LUNAMON_ENABLE_NMEA_BRIDGE
        help
            The interface on which bridged messages are sent out.

        config LUNAMON_NMEA_BRIDGE_DESTINATION_WIFI
            bool "WiFi" if LUNAMON_HAS_NMEA_OVER_WIFI_SOURCE
        config LUNAMON_NMEA_BRIDGE_DESTINATION_UART1
            bool "UART1" if LUNAMON_UART1_NMEA_0183
        config LUNAMON_NMEA_BRIDGE_DESTINATION_UART2
            bool "UART2" if LUNAMON_UART2_NMEA_0183
        config LUNAMON_NMEA_BRIDGE_DESTINATION_RMT_UART
            bool "RMT UART" if LUNAMON_RMT_UART_NMEA_0183
        config LUNAMON_NMEA_BRIDGE_DESTINATION_SOFT_UART
            bool "Software UART" if LUNAMON_SOFTWARE_UART_NMEA_0183
    endchoice

    config LUNAMON_NMEA_BRIDGE_DESTINATION_NONE
        bool
        default y if !LUNAMON_ENABLE_NMEA_BRIDGE
        default y if !LUNAMON_NMEA_BRIDGE_DESTINATION_WIFI &&       \
                     !LUNAMON_NMEA_BRIDGE_DESTINATION_UART1 &&      \
                     !LUNAMON_NMEA_BRIDGE_DESTINATION_UART2 &&      \
                     !LUNAMON_NMEA_BRIDGE_DESTINATION_RMT_UART &&   \
                     !LUNAMON_NMEA_BRIDGE_DESTINATION_SOFT_UART

    config LUNAMON_NMEA_BRIDGE_MESSAGE_TYPES
        string "Bridged message types" if LUNAMON_ENABLE_NMEA_BRIDGE
        default ""
        help
            A comma separated list of NMEA message types (typically three letters) to be
            bridged.

endmenu
```

## main/Config/Kconfig.NMEAServer
```kconfig
menu "NMEA 0183 Server Configuration"

    config LUNAMON_ENABLE_NMEA_SERVER
        bool "Enable NMEA 0183 over TCP/IP Server"
        default n
        help
            Whether or not enable a server providing NMEA 0183 messages over TCP/IP.

    config LUNAMON_NMEA_SERVER_ENABLED
        int
        default 1 if LUNAMON_ENABLE_NMEA_SERVER
        default 0 if !LUNAMON_ENABLE_NMEA_SERVER

    config LUNAMON_NMEA_SERVER_KNOWN_PORT
        int "NMEA 0183 TCP Known Port Number" if LUNAMON_ENABLE_NMEA_SERVER
        default 10110
        help
            Known TCP port number for the NMEA 0183 over TCP/IP server to listen on for new
            connections.

    config LUNAMON_NMEA_SERVER_MAX_CLIENTS
        int "Max NMEA Server Clients" if LUNAMON_ENABLE_NMEA_SERVER
        default 5
        help
            Maximum number of allowed NMEA 0183 Server clients active at one time.

    config LUNAMON_NMEA_SERVER_TCP_KEEPALIVE_IDLE
        int "TCP keep-alive idle time(s)" if LUNAMON_ENABLE_NMEA_SERVER
        default 5
        help
            Keep-alive idle time. In idle time without receiving any data from peer, will send
            keep-alive probe packet.

    config LUNAMON_NMEA_SERVER_TCP_KEEPALIVE_INTERVAL
        int "TCP keep-alive interval time(s)" if LUNAMON_ENABLE_NMEA_SERVER
        default 5
        help
            Keep-alive probe packet interval time.

    config LUNAMON_NMEA_SERVER_TCP_KEEPALIVE_COUNT
        int "TCP keep-alive packet retry send counts" if LUNAMON_ENABLE_NMEA_SERVER
        default 3
        help
            Keep-alive probe packet retry count.

endmenu
```

## main/Config/Kconfig.RMTUART
```kconfig
menu "RMT UART Source Configuration"

    config LUNAMON_HAS_RMT_UART_SOURCE
        bool "Has a serial source connected for a RMT based UART"
        default n
        help
            Whether or not there's a serial source connected to be configured as a RMT UART.

    config LUNAMON_RMT_UART_ENABLED
        int
        default 1 if LUNAMON_HAS_RMT_UART_SOURCE
        default 0 if !LUNAMON_HAS_RMT_UART_SOURCE

    config LUNAMON_RMT_UART_LABEL
        string "RMT UART interface label" if LUNAMON_HAS_RMT_UART_SOURCE
        default ""
        help
            The label of the RMT UART interface.

    choice
        prompt "RMT UART Protocol" if LUNAMON_HAS_RMT_UART_SOURCE
        default LUNAMON_RMT_UART_NMEA_0183
        help
            Luna Mon supports interfaces with either NMEA 0183, SeaTalk or $STALK messages.
            NMEA 0183 is what is typically put out by older, non-Raymarine devices. SeaTalk
            is a proprietary protocol used by AutoHelm and Raymarine devices. $STALK is a
            packaging of SeaTalk messages into a NMEA 0183 message structure typically
            outputed by bridging devices such as the Digital Yachts ST-NMEA.

        config LUNAMON_RMT_UART_NMEA_0183
            bool "NMEA 0183"
        config LUNAMON_RMT_UART_STALK
            bool "$STALK"
        config LUNAMON_RMT_UART_SEA_TALK
            bool "SeaTalk"
    endchoice

    config LUNAMON_RMT_UART_OFFLINE
        bool
        default y if !LUNAMON_HAS_RMT_UART_SOURCE

    config LUNAMON_RMT_UART_RX_GPIO
        int "RMT UART RX GPIO" if LUNAMON_HAS_RMT_UART_SOURCE
        default 9
        help
            Pin number to use for the RMT UART's RX GPIO. Consult your board documentation for
            information on which pin to use.

    config LUNAMON_RMT_UART_TX_GPIO
        int "RMT UART TX GPIO"  if LUNAMON_HAS_RMT_UART_SOURCE
        default 10
        help
            Pin number to use for the RMT UART's TX GPIO. Consult your board documentation for
            information on which pin to use.

    choice
        prompt "RMT UART Baud Rate" if LUNAMON_RMT_UART_NMEA_0183 || LUNAMON_RMT_UART_STALK
        default LUNAMON_RMT_UART_BAUD_RATE_4800
        help
            There are two baud rates used by NMEA 0183 devices, 4800 and 38400. Most devices
            use the former while AIS transceivers typically use the later. Since these are
            incompatible to directly connect, vessels would usually either run one of each to
            each MFD, or use a device (often the AIS) to bridge the slower feed onto the faster.
            SeaTalk runs native 4800 while a $STALK translation device might be 4800 or 38400.
            Select the speed of what's connected to UART2.

        config LUNAMON_RMT_UART_BAUD_RATE_4800
            bool "4800"
        config LUNAMON_RMT_UART_BAUD_RATE_38400
            depends on LUNAMON_RMT_UART_NMEA_0183 || LUNAMON_RMT_UART_STALK
            bool "38400"
    endchoice

    config LUNAMON_RMT_UART_BAUD_RATE
        int
        default 0 if !LUNAMON_HAS_RMT_UART_SOURCE
        default 4800 if LUNAMON_RMT_UART_SEA_TALK
        default 4800 if LUNAMON_RMT_UART_BAUD_RATE_4800
        default 38400 if LUNAMON_RMT_UART_BAUD_RATE_38400

endmenu
```

## main/Config/Kconfig.SeaTalkNMEABridge
```kconfig
menu "SeaTalk to NMEA 0183 Bridge Configuration"

    config LUNAMON_ENABLE_SEA_TALK_NMEA_BRIDGE
        bool "Enable a SeaTalk to NMEA 0183 message bridge"
        default n
        help
            Whether or not enable a bridge of messages between a SeaTalk interface and a NMEA 0183
            interface.

    config LUNAMON_SEA_TALK_NMEA_BRIDGE_ENABLED
        int
        default 1 if LUNAMON_ENABLE_SEA_TALK_NMEA_BRIDGE
        default 0 if !LUNAMON_ENABLE_SEA_TALK_NMEA_BRIDGE

    config LUNAMON_SEA_TALK_NMEA_BRIDGE_LABEL
        string "Bridge Label" if LUNAMON_ENABLE_SEA_TALK_NMEA_BRIDGE
        default ""
        help
            The label to assign to the bridge as shown in an MQTT $SYS topic.

    choice
        prompt "Bridge source interface" if LUNAMON_ENABLE_SEA_TALK_NMEA_BRIDGE
        help
            The interface on which bridged messages are expected. This must be configured as a
            SeaTalk source.

        config LUNAMON_SEA_TALK_NMEA_BRIDGE_SOURCE_UART1
            bool "UART1" if LUNAMON_UART1_STALK
        config LUNAMON_SEA_TALK_NMEA_BRIDGE_SOURCE_UART2
            bool "UART2" if LUNAMON_UART2_STALK
        config LUNAMON_SEA_TALK_NMEA_BRIDGE_SOURCE_RMT_UART
            bool "RMT UART" if LUNAMON_RMT_UART_SEA_TALK || LUNAMON_RMT_UART_STALK
    endchoice

    config LUNAMON_SEA_TALK_NMEA_BRIDGE_SOURCE_NONE
        bool
        default y if !LUNAMON_ENABLE_SEA_TALK_NMEA_BRIDGE
        default y if !LUNAMON_UART1_STALK &&        \
                     !LUNAMON_UART2_STALK &&        \
                     !LUNAMON_RMT_UART_SEA_TALK &&  \
                     !LUNAMON_RMT_UART_STALK

    choice
        prompt "Bridge destination" if LUNAMON_ENABLE_SEA_TALK_NMEA_BRIDGE
        help
            The interface or NMEA Server on which bridged messages are sent out.

        config LUNAMON_SEA_TALK_NMEA_BRIDGE_DESTINATION_WIFI
            bool "WiFi" if LUNAMON_HAS_NMEA_OVER_WIFI_SOURCE
        config LUNAMON_SEA_TALK_NMEA_BRIDGE_DESTINATION_UART1
            bool "UART1" if LUNAMON_UART1_NMEA_0183
        config LUNAMON_SEA_TALK_NMEA_BRIDGE_DESTINATION_UART2
            bool "UART2" if LUNAMON_UART2_NMEA_0183
        config LUNAMON_SEA_TALK_NMEA_BRIDGE_DESTINATION_RMT_UART
            bool "RMT UART" if LUNAMON_RMT_UART_NMEA_0183
        config LUNAMON_SEA_TALK_NMEA_BRIDGE_DESTINATION_SOFT_UART
            bool "Software UART" if LUNAMON_SOFTWARE_UART_NMEA_0183
        config LUNAMON_SEA_TALK_NMEA_BRIDGE_DESTINATION_NMEA_SERVER
            bool "NMEA Server" if LUNAMON_ENABLE_NMEA_SERVER
    endchoice

    config LUNAMON_SEA_TALK_NMEA_BRIDGE_DESTINATION_NONE
        bool
        default y if !LUNAMON_ENABLE_SEA_TALK_NMEA_BRIDGE
        default y if !LUNAMON_NMEA_BRIDGE_DESTINATION_WIFI &&       \
                     !LUNAMON_NMEA_BRIDGE_DESTINATION_UART1 &&      \
                     !LUNAMON_NMEA_BRIDGE_DESTINATION_UART2 &&      \
                     !LUNAMON_NMEA_BRIDGE_DESTINATION_RMT_UART &&   \
                     !LUNAMON_NMEA_BRIDGE_DESTINATION_SOFT_UART &&  \
                     !LUNAMON_ENABLE_NMEA_SERVER

    config LUNAMON_SEA_TALK_NMEA_BRIDGE_TALKER_CODE
        string "SeaTalk NMEA Bridge Talker Code" if LUNAMON_ENABLE_SEA_TALK_NMEA_BRIDGE
        default "II"
        help
            The NMEA 0183 Talker Code to use for messages bridged from SeaTalk to NMEA. This must
            be two characters and should be chosen from the list of defined codes. See
            https://gpsd.gitlab.io/gpsd/NMEA.html#_talker_ids for details.

endmenu
```

## main/Config/Kconfig.SoftwareUART
```kconfig
menu "Software UART Source Configuration (Not recommended)"

    config LUNAMON_HAS_SOFTWARE_UART_SOURCE
        bool "Has a serial source connected for the Software UART"
        default n
        help
            Whether or not there's a serial source connected to be configured as a software UART.

    config LUNAMON_SOFTWARE_UART_ENABLED
        int
        default 1 if LUNAMON_HAS_SOFTWARE_UART_SOURCE
        default 0 if !LUNAMON_HAS_SOFTWARE_UART_SOURCE

    config LUNAMON_SOFTWARE_UART_LABEL
        string "Software UART interface label" if LUNAMON_HAS_SOFTWARE_UART_SOURCE
        default ""
        help
            The label of the software UART interface.

    choice
        prompt "Software UART Protocol" if LUNAMON_HAS_SOFTWARE_UART_SOURCE
        default LUNAMON_SOFTWARE_UART_NMEA_0183
        help
            Luna Mon supports interfaces with either NMEA 0183, SeaTalk or $STALK messages.
            NMEA 0183 is what is typically put out by older, non-Raymarine devices. SeaTalk
            is a proprietary protocol used by AutoHelm and Raymarine devices. $STALK is a
            packaging of SeaTalk messages into a NMEA 0183 message structure typically outputed
            by bridging devices such as the Digital Yachts ST-NMEA.

        config LUNAMON_SOFTWARE_UART_NMEA_0183
            bool "NMEA 0183"
        endchoice

    config LUNAMON_SOFTWARE_UART_OFFLINE
        bool
        default y if !LUNAMON_HAS_SOFTWARE_UART_SOURCE

    config LUNAMON_SOFTWARE_UART_RX_PIN
        int "Software UART RX Pin" if LUNAMON_HAS_SOFTWARE_UART_SOURCE
        default 5
        help
            Pin number to use for the software UART's RX pin. Consult your board documentation
            for information on which pin to use.

    config LUNAMON_SOFTWARE_UART_TX_PIN
        int "Software UART TX Pin" if LUNAMON_HAS_SOFTWARE_UART_SOURCE
        default 4
        help
            Pin number to use for the software UART's TX pin. Consult your board documentation
            for information on which pin to use.

    config LUNAMON_SOFTWARE_UART_NMEA_0183_FILTERED_TALKERS
        string "Filtered NEMA 0183 Talkers" if LUNAMON_SOFTWARE_UART_NMEA_0183
        default ""
        help
            A comma separated list of NMEA talker codes from whom messages are to be filtered.

endmenu
```
